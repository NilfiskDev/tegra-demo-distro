## layers/meta-mli/conf/distro/mli.conf
```bitbake
require conf/distro/include/mli.inc

INHERIT += "tegra-support-sanity"
ESDK_CLASS_INHERIT_DISABLE:append = " tegra-support-sanity"

BB_SIGNATURE_HANDLER ?= "OEEquivHash"
BB_HASHSERVE ??= "auto"

DISTRO_FEATURES += "polkit wifi ufw"
```

## layers/meta-mli/conf/layer.conf
```bitbake
BBPATH =. "${LAYERDIR}:"
BBFILES += "${LAYERDIR}/recipes-*/*/*.bb ${LAYERDIR}/recipes-*/*/*.bbappend"
BBFILES_DYNAMIC += "swupdate:${LAYERDIR}/dynamic-layers/meta-swupdate/recipes-*/*/*.bb \
                    swupdate:${LAYERDIR}/dynamic-layers/meta-swupdate/recipes-*/*/*.bbappend"

BBFILE_COLLECTIONS += "mli"
BBFILE_PATTERN_mli = "^${LAYERDIR}/"
BBFILE_PRIORITY_mli = "50"

LAYERVERSION_mli = "4"
LAYERSERIES_COMPAT_mli = "styhead walnascar"

# This is used by the tegra-distro-sanity bbclass
# to identify the distro layer directory during
# bblayers checks.
TD_DISTRO_LAYERDIR = "${LAYERDIR}"
```

## layers/meta-plink/conf/layer.conf
```bitbake
# We have a conf and classes directory, add to BBPATH
BBPATH .= ":${LAYERDIR}"

# We have recipes-* directories, add to BBFILES
BBFILES += "${LAYERDIR}/recipes-*/*/*.bb \
            ${LAYERDIR}/recipes-*/*/*.bbappend"

BBFILE_COLLECTIONS += "meta-plink"
BBFILE_PATTERN_meta-plink = "^${LAYERDIR}/"
BBFILE_PRIORITY_meta-plink = "6"

BBFILES += "${@' '.join('${LAYERDIR}/external/%s/recipes*/*/*.bb' % layer \
               for layer in BBFILE_COLLECTIONS.split() if os.path.exists(os.path.join('${LAYERDIR}','external',layer)))}"
BBFILES += "${@' '.join('${LAYERDIR}/external/%s/recipes*/*/*.bbappend' % layer \
               for layer in BBFILE_COLLECTIONS.split() if os.path.exists(os.path.join('${LAYERDIR}','external',layer)))}"

LAYERDEPENDS_meta-plink = "core tegra"
LAYERSERIES_COMPAT_meta-plink = "styhead walnascar"
```

## layers/meta-plink/conf/machine/jetson-plink-11f1e2.conf
```bitbake
#@TYPE: Machine
#@NAME: Nvidia Jetson Plink AI 11F1E2
#@DESCRIPTION: Nvidia Jetson Plink AI 11F1E2 custom carrier board

MACHINEOVERRIDES =. "jetson-orin-nano-plink-11f1e2:"
TNSPEC_BOOTDEV ?= "nvme0n1p1"

PARTITION_LAYOUT_TEMPLATE_DEFAULT ?= "flash_t234_qspi.xml"
PARTITION_LAYOUT_TEMPLATE_DEFAULT_SUPPORTS_REDUNDANT ?= "1"
PARTITION_LAYOUT_EXTERNAL_DEFAULT ?= "flash_l4t_t234_nvme.xml"

TEGRA_BOARDSKU = "0004"
PREFERRED_PROVIDER_virtual/dtb ?= "nvidia-kernel-oot-dtb"
KERNEL_ARGS ?= "mminit_loglevel=4 firmware_class.path=/etc/firmware fbcon=map:0 nospectre_bhb video=efifb:off console=tty0 quiet"
KERNEL_DEVICETREE ?= "y-c11-orin-nano-3643-04-super.dtb "
NVPMODEL ?= "nvpmodel_p3767_0004_super"
EMMC_BCT ?= "tegra234-p3767-0004-sdram-l4t.dts"
TEGRA_BOOTCONTROL_OVERLAYS = "BootOrderNvme.dtbo"

TEGRA_FLASHVAR_BPFDTB_FILE ?= "tegra234-bpmp-3767-0004-3768-super.dtb"
TEGRA_FLASHVAR_CHIP_SKU ?= "00:00:00:D6"
TEGRA_FLASHVAR_RAMCODE ?= "4"
TEGRA_FLASHVAR_WB0SDRAM_BCT ?= "tegra234-p3767-0004-wb0sdram-l4t.dts"

TEGRA_BUPGEN_SPECS ?= "fab=000;boardsku=0004;boardrev=;chipsku=00:00:00:D6;bup_type=bl \
                       fab=000;boardsku=0004;boardrev=;bup_type=kernel"

# Items specific to the Plink AI 11F1E2 carrier board
TEGRA_FLASHVAR_MB2BCT_CFG = "tegra234-mb2-bct-misc-p3767-plink.dts"
TEGRA_FLASHVAR_PINMUX_CONFIG = "tegra234-mb1-bct-pinmux-p3767-hdmi-c11.dtsi"
TEGRA_FLASHVAR_PMC_CONFIG = "tegra234-mb1-bct-padvoltage-p3767-hdmi-a03.dtsi"

ROOTFSPART_SIZE_DEFAULT ?= "7064771072"
MACHINE_FEATURES += "wifi bluetooth"

# Default to SUPER_MAXN power mode
NVPMODEL_CONFIG_DEFAULT ?= "2"
SERIAL_CONSOLES = "115200;ttyGS0"

require conf/machine/include/orin-nano.inc
```
